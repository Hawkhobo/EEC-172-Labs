/**
 * @cliArgs --device "CC3200" --package "Default" --part "Default"
 * @versions {"tool":"1.18.0+3266"}
 */
scripting.excludeFromBuild("rom_pin_mux_config.c");
scripting.excludeFromBuild("summary.csv");

/**
 * These are the peripherals and settings in this configuration
 */
const iGPIO1        = scripting.addPeripheral("GPIO");
iGPIO1.$name        = "MyGPIO1";
iGPIO1.GPIO00.$used = false;
iGPIO1.GPIO01.$used = false;
iGPIO1.GPIO02.$used = false;
iGPIO1.GPIO03.$used = false;
iGPIO1.GPIO04.$used = false;
iGPIO1.GPIO05.$used = false;
iGPIO1.GPIO06.$used = false;
iGPIO1.GPIO07.$used = false;
iGPIO1.GPIO08.$used = false;
iGPIO1.GPIO09.io    = "output";
iGPIO1.GPIO10.io    = "output";
iGPIO1.GPIO11.io    = "output";
iGPIO1.GPIO12.io    = "output";
iGPIO1.GPIO12.$used = false;
iGPIO1.GPIO13.io    = "output";
iGPIO1.GPIO13.$used = false;
iGPIO1.GPIO14.$used = false;
iGPIO1.GPIO16.$used = false;
iGPIO1.GPIO17.$used = false;
iGPIO1.GPIO22.$used = false;
iGPIO1.GPIO23.$used = false;
iGPIO1.GPIO24.$used = false;
iGPIO1.GPIO28.$used = false;
iGPIO1.GPIO29.$used = false;
iGPIO1.GPIO25.$used = false;
iGPIO1.GPIO30.$used = false;
iGPIO1.GPIO31.$used = false;
iGPIO1.GPIO32.$used = false;
const iSPI1         = scripting.addPeripheral("SPI");
iSPI1.$name         = "MySPI1";
const iUART1        = scripting.addPeripheral("UART");
iUART1.$name        = "MyUART1";
iUART1.RTS.$used    = false;
iUART1.CTS.$used    = false;

/**
 * Pinmux solution for unlocked pins/peripherals. This ensures that minor changes to the automatic solver in a future
 * version of the tool will not impact the pinmux you originally saw.  These lines can be completely deleted in order to
 * re-solve from scratch.
 */
iGPIO1.$suggestSolution        = "GPIO";
iGPIO1.GPIO09.$suggestSolution = "GP09";
iGPIO1.GPIO10.$suggestSolution = "GP10";
iGPIO1.GPIO11.$suggestSolution = "GP11";
iGPIO1.GPIO15.$suggestSolution = "GP15";
iSPI1.$suggestSolution         = "SPI0";
iSPI1.CS.$suggestSolution      = "GP00";
iSPI1.CLK.$suggestSolution     = "GP14";
iSPI1.MISO.$suggestSolution    = "GP30";
iSPI1.MOSI.$suggestSolution    = "GP16";
iUART1.$suggestSolution        = "UART0";
iUART1.TX.$suggestSolution     = "GP01";
iUART1.RX.$suggestSolution     = "GP02";
